## sdkconfig.defaults.old
```kconfig
CONFIG_MAIN_TASK_STACK_SIZE=8192
CONFIG_DPP_TASK_STACK_SIZE=8192
CONFIG_ESP_WIFI_DPP_SUPPORT=y
CONFIG_WPA_11KV_SUPPORT=y
CONFIG_WPA_SCAN_CACHE=y
CONFIG_WPA_MBO_SUPPORT=y
CONFIG_WPA_DPP_SUPPORT=y
```
